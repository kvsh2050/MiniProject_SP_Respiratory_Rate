#include <SPI.h>
#include<SD.h>
#define PI 3.1415926535897932384626433832795
/*https://archive.physionet.org/cgi-bin/atm/ATM */

void dft(const double inrealn[],double outreal[],double outimg[],double magi[],size_t n);//for n number of samples
float maxi(float a, float b);

double inreal[1500]={0.2593,0.4559,0.394,0.4186,0.4035,0.4127,0.4098,0.496,0.5763,0.6014,0.5985,0.5585,0.5038,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0.6241
};

void setup() {
  // put your setup code here, to run once:
  Serial.begin(115200);
}

void loop() {
  // preprocessing 
  //mean 
  int n=1500;

  /*for(int i=0;i<n;i++){
    Serial.print(i);
    Serial.print(" ");
    Serial.println(inreal[i]);
  }// for plotting the original signal*/
  
  double sum1=0;
  for(int j=0;j<n;j++){ 
    sum1=sum1+inreal[j];
    
  }
  //Serial.println(sum1);
  
  //find mean
  double mean=sum1/n;
  //Serial.println(mean);          //all clear
  
  for(int i=0;i<n;i++)
  {
    inreal[i]=inreal[i]-mean;
  }
  /*for(int i=0;i<n;i++)
  {
     Serial.println( inreal[i]);
  }*/
  
  //find max value
  double maxVal = inreal[0];
  
  for (int i = 1; i < n; i++) {
      if (inreal[i] > maxVal) {
         maxVal = inreal[i];
      }
      else{
        //
      }
   }
   //Serial.println(maxVal);  //fine
   
   //normalise the signal
   for(int j=0;j<n;j++){
     inreal[j]=inreal[j]/maxVal;
     //Serial.println(inreal[j]);  //fine
   }

   //this is for coefficient calculation for resonator
   double a1=-2*0.997*cos(0.3*2*PI);
   double a2=0.997*0.997;
   double b=(1-0.997)*sqrt(1+(0.997*0.997)-2*0.997*cos(2*0.3));
   

  //resonator
  double inrealn[1500]={};
  
  for(int j=2;j<n;j++){
    inrealn[j]=-a1*inrealn[j-1]-a2*inrealn[j-2]+b*inreal[j];
  }
  
  //dft
  //double inmg[250]={};
  double outreal[1500]={};
  double outimg[1500]={};
  double magi[1500]={};
  
  dft(inrealn,outreal,outimg,magi,n);//works good
  //Serial.println(magi[],6);  
  /*for(int i=0;i<n;i++){
    //Serial.print(i);
    //Serial.print(",");
    Serial.println(magi[i],6);   //
  }// this is for plotting magnitude spectrum*/

  //find maximum peak in spectrum
  double fmaxi = -100000.00;
  
  for (int i = 0; i < n; i++) {
    fmaxi = maxi(magi[i],fmaxi);
    //Serial.println(fmaxi);
    
    // delay(10);
  }
  
  
  //find breathing rate
  double resp_rate=fmaxi*60;
  Serial.println(resp_rate);
}

//for dft
void dft(const double inrealn[],double outreal[],double outimg[],double magi[],size_t n){//double inmg is removed ass it is asumed to be 0
  
    for (int k=0;k<n;k++){
      double sumreal=0;
      double sumimg=0;
      for (int t=0;t<n;t++){
          double angles=2*PI*t*k/n;
          sumreal+=inrealn[t]*cos(angles);
          sumimg+=-inrealn[t]*sin(angles);
         
      }
      
      outreal[k]=sumreal;
      outimg[k]=sumimg;
      magi[k]=sqrt(pow(outreal[k],2)+pow(outimg[k],2));
      //Serial.println(k); 
      //Serial.println(','); 
      //Serial.println(magi[k],6);  //works good
    }
}

float maxi(float a, float b){
    if(a>b){
        return a;
    }
    else{
        return b;
    }
    
}